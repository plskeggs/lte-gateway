## boards/arm/apricity_gateway_nrf9160/Kconfig
```kconfig
# Apricity Gateway nRF9160 board configuration
#
# Copyright (c) 2020 Nordic Semiconductor ASA
#
# SPDX-License-Identifier: LicenseRef-BSD-5-Clause-Nordic

module=BOARD
module-dep=LOG
module-str=Log level for board
source "${ZEPHYR_BASE}/subsys/logging/Kconfig.template.log_config"

config BOARD_NRF52840_GPIO_RESET
        bool "Use nRF52840 PCA20035 GPIO reset pin"
        default y
        help
          Use a GPIO pin to reset the nRF52840 controller and let it wait
          until all bytes traveling to the nRF52 device have been received
          and drained, thus ensuring communication can begin correctly.

if BOARD_NRF52840_GPIO_RESET

config BOARD_NRF52840_GPIO_RESET_PIN
        int "Reset pin"
        default 13
        help
          GPIO pin on the nRF9160 used to reset the nRF52840.

endif
```

## west.yml
```yaml
manifest:
  remotes:
    - name: nrfcloud
      url-base: https://github.com/nRFCloud
    - name: nordic
      url-base: https://github.com/nrfconnect
  projects:
    - name: sdk-nrf
      path: nrf
      remote: nrfcloud
      revision: 389568e7e09a399f40e34fb7fa47ee1bd733c924
      import: true
  self:
    path: lte-gateway
```
